#include <ASCON.h>
#include <string.h>

#if defined(__AVR__)
#include <avr/pgmspace.h>
#else
#undef PROGMEM
#undef memcpy_P
#define PROGMEM
#define memcpy_P(d,s,l) memcpy((d),(s),(l))
#endif

#define MAX_PLAINTEXT 32
#define MAX_ASSOCIATED_DATA 32

struct TestVector {
  const char *name;
  uint8_t key[16];
  uint8_t nonce[16];
  uint8_t associatedData[MAX_ASSOCIATED_DATA];
  size_t  associatedDataLength;
  uint8_t plaintext[MAX_PLAINTEXT];
  size_t  plaintextLength;
  uint8_t expectedCiphertext[MAX_PLAINTEXT + 16];   // ciphertext || tag esperados
  size_t  expectedCiphertextLength;
};

static const TestVector vectors[] PROGMEM = {
  {
    .name  = "PT=0 AD=0",
    .key   = {0x00, 0x01, 0x02, 0x03, 0x04, 0x05, 0x06, 0x07, 0x08, 0x09, 0x0a, 0x0b, 0x0c, 0x0d, 0x0e, 0x0f},
    .nonce = {0x00, 0x01, 0x02, 0x03, 0x04, 0x05, 0x06, 0x07, 0x08, 0x09, 0x0a, 0x0b, 0x0c, 0x0d, 0x0e, 0x0f},
    .associatedData = {0}, .associatedDataLength = 0,
    .plaintext      = {0}, .plaintextLength      = 0,
    .expectedCiphertext = {0x7a, 0x83, 0x4e, 0x6f, 0x09, 0x21, 0x09, 0x57, 0x06, 0x7b, 0x10, 0xfd, 0x83, 0x1f, 0x00, 0x78}, .expectedCiphertextLength = 16
  },
  {
    .name  = "PT=0 AD=16",
    .key   = {0x00, 0x01, 0x02, 0x03, 0x04, 0x05, 0x06, 0x07, 0x08, 0x09, 0x0a, 0x0b, 0x0c, 0x0d, 0x0e, 0x0f},
    .nonce = {0x00, 0x01, 0x02, 0x03, 0x04, 0x05, 0x06, 0x07, 0x08, 0x09, 0x0a, 0x0b, 0x0c, 0x0d, 0x0e, 0x0f},
    .associatedData = {0x00, 0x01, 0x02, 0x03, 0x04, 0x05, 0x06, 0x07, 0x08, 0x09, 0x0a, 0x0b, 0x0c, 0x0d, 0x0e, 0x0f}, .associatedDataLength = 16,
    .plaintext      = {0}, .plaintextLength      = 0,
    .expectedCiphertext = {0x56, 0xc1, 0x5e, 0xb0, 0x24, 0xde, 0x91, 0xca, 0x01, 0x65, 0x36, 0x2a, 0x49, 0xb3, 0x1e, 0xbd}, .expectedCiphertextLength = 16
  },
  {
    .name  = "PT=5 AD=0",
    .key   = {0x00, 0x01, 0x02, 0x03, 0x04, 0x05, 0x06, 0x07, 0x08, 0x09, 0x0a, 0x0b, 0x0c, 0x0d, 0x0e, 0x0f},
    .nonce = {0x00, 0x01, 0x02, 0x03, 0x04, 0x05, 0x06, 0x07, 0x08, 0x09, 0x0a, 0x0b, 0x0c, 0x0d, 0x0e, 0x0f},
    .associatedData = {0}, .associatedDataLength = 0,
    .plaintext      = {0x00, 0x01, 0x02, 0x03, 0x04}, .plaintextLength = 5,
    .expectedCiphertext = {0x6e, 0x49, 0x0c, 0xfe, 0xd5, 0xf1, 0x2c, 0x2f, 0xeb, 0x11, 0xe2, 0xf1, 0xad, 0xc2, 0x55, 0xf8, 0x8e, 0x98, 0x7c, 0x9d, 0xdc}, .expectedCiphertextLength = 21
  },
  {
    .name  = "PT=16 AD=0",
    .key   = {0x00, 0x01, 0x02, 0x03, 0x04, 0x05, 0x06, 0x07, 0x08, 0x09, 0x0a, 0x0b, 0x0c, 0x0d, 0x0e, 0x0f},
    .nonce = {0x00, 0x01, 0x02, 0x03, 0x04, 0x05, 0x06, 0x07, 0x08, 0x09, 0x0a, 0x0b, 0x0c, 0x0d, 0x0e, 0x0f},
    .associatedData = {0}, .associatedDataLength = 0,
    .plaintext      = {0x00, 0x01, 0x02, 0x03, 0x04, 0x05, 0x06, 0x07, 0x08, 0x09, 0x0a, 0x0b, 0x0c, 0x0d, 0x0e, 0x0f}, .plaintextLength = 16,
    .expectedCiphertext = {0x6e, 0x49, 0x0c, 0xfe, 0xd5, 0xb3, 0x54, 0x67, 0x67, 0x35, 0x0c, 0xd8, 0x3c, 0x4a, 0xcf, 0xbd, 0xb1, 0x0f, 0x61, 0x1b, 0x7d, 0x79, 0x27, 0x8b, 0xd8, 0x06, 0x7f, 0xc1, 0xbc, 0xdf, 0x39, 0xbe}, .expectedCiphertextLength = 32
  },
  {
    .name  = "PT=1 AD=1",
    .key   = {0x00, 0x01, 0x02, 0x03, 0x04, 0x05, 0x06, 0x07, 0x08, 0x09, 0x0a, 0x0b, 0x0c, 0x0d, 0x0e, 0x0f},
    .nonce = {0x00, 0x01, 0x02, 0x03, 0x04, 0x05, 0x06, 0x07, 0x08, 0x09, 0x0a, 0x0b, 0x0c, 0x0d, 0x0e, 0x0f},
    .associatedData = {0x00}, .associatedDataLength = 1,
    .plaintext      = {0x00}, .plaintextLength      = 1,
    .expectedCiphertext = {0xe9, 0xc2, 0x81, 0x3c, 0xc8, 0xc6, 0xdd, 0x2f, 0x24, 0x5f, 0x3b, 0xb9, 0x76, 0xda, 0x56, 0x6e, 0x9d}, .expectedCiphertextLength = 17
  },
  {
    .name  = "PT=32 AD=32",
    .key   = {0x00, 0x01, 0x02, 0x03, 0x04, 0x05, 0x06, 0x07, 0x08, 0x09, 0x0a, 0x0b, 0x0c, 0x0d, 0x0e, 0x0f},
    .nonce = {0x00, 0x01, 0x02, 0x03, 0x04, 0x05, 0x06, 0x07, 0x08, 0x09, 0x0a, 0x0b, 0x0c, 0x0d, 0x0e, 0x0f},
    .associatedData = {0x00, 0x01, 0x02, 0x03, 0x04, 0x05, 0x06, 0x07, 0x08, 0x09, 0x0a, 0x0b, 0x0c, 0x0d, 0x0e, 0x0f, 0x10, 0x11, 0x12, 0x13, 0x14, 0x15, 0x16, 0x17, 0x18, 0x19, 0x1a, 0x1b, 0x1c, 0x1d, 0x1e, 0x1f}, .associatedDataLength = 32,
    .plaintext      = {0x00, 0x01, 0x02, 0x03, 0x04, 0x05, 0x06, 0x07, 0x08, 0x09, 0x0a, 0x0b, 0x0c, 0x0d, 0x0e, 0x0f, 0x10, 0x11, 0x12, 0x13, 0x14, 0x15, 0x16, 0x17, 0x18, 0x19, 0x1a, 0x1b, 0x1c, 0x1d, 0x1e, 0x1f}, .plaintextLength = 32,
    .expectedCiphertext = {0xa5, 0x52, 0x36, 0xac, 0x02, 0x0d, 0xbd, 0xa7, 0x4c, 0xe6, 0xcc, 0xd1, 0x0c,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 0x38, 0xd5}, .expectedCiphertextLength = 48
  }
};

#define TEST_VECTOR_COUNT (sizeof(vectors) / sizeof(vectors[0]))

static TestVector currentVector;
static uint8_t encryptOutput[MAX_PLAINTEXT + 16];
static uint8_t decryptOutput[MAX_PLAINTEXT];

static bool runVector(const TestVector *vector)
{
  size_t ciphertextLength = 0, messageLength = 0;

  // (1) Cifra e compara com o (ciphertext || tag) esperado.
  ascon128a_aead_encrypt(encryptOutput, &ciphertextLength,
                         vector->plaintext, vector->plaintextLength,
                         vector->associatedData, vector->associatedDataLength,
                         vector->nonce, vector->key);

  if (ciphertextLength != vector->expectedCiphertextLength ||
      memcmp(encryptOutput, vector->expectedCiphertext, vector->expectedCiphertextLength) != 0)
  {
    return false;
  }

  // (2) Decifra o valor esperado e confirma texto claro + tag valida.
  int decryptResult = ascon128a_aead_decrypt(decryptOutput, &messageLength,
                                             vector->expectedCiphertext, vector->expectedCiphertextLength,
                                             vector->associatedData, vector->associatedDataLength,
                                             vector->nonce, vector->key);
                                             
  if (decryptResult < 0 || messageLength != vector->plaintextLength)
  {
    return false;
  }

  if (vector->plaintextLength &&
      memcmp(decryptOutput, vector->plaintext, vector->plaintextLength) != 0)
  {
    return false;
  }

  return true;
}

void setup()
{
  Serial.begin(115200);
  delay(300);

  Serial.println();
  Serial.println("=== Ascon-128a KAT (on-device, ESP32) ===");
  Serial.print("Estado incremental (bytes): ");
  Serial.println((unsigned) sizeof(ascon128a_state_t));
  Serial.println();

  int passedCount = 0;
  for (size_t vectorIndex = 0; vectorIndex < TEST_VECTOR_COUNT; vectorIndex++) {
    memcpy_P(&currentVector, &vectors[vectorIndex], sizeof(TestVector));

    Serial.print(currentVector.name);
    Serial.print(" ... ");

    if (runVector(&currentVector)) {
      Serial.println("OK");
      passedCount++;
    }
    else {
      Serial.println("FALHOU");
    }
  }

  Serial.println();
  Serial.print("Resultado: ");
  Serial.print(passedCount);
  Serial.print("/");
  Serial.print((int) TEST_VECTOR_COUNT);
  Serial.println(" vetores passaram.");

  if (passedCount == (int) TEST_VECTOR_COUNT) {
    Serial.println(">>> TODOS OS VETORES PASSARAM NA PLACA <<<");
  }
  else {
    Serial.println(">>> FALHA: divergencia na placa <<<");
  }
}

void loop()
{
  // O teste roda uma vez no setup(). Um loop() vazio fica em "busy-spin" no
  // ESP32: satura um nucleo da CPU e impede a tarefa ociosa de rodar, o que
  // dispara o watchdog, que inunda a Serial e trava o Monitor Serial.
  // O delay() cede o processador e elimina esse comportamento.
  delay(1000);
}
